## x_track/Build/kconfig/kconfig
```kconfig
#
# For a description of the syntax of this configuration file,
# see build/scripts/Documentation/kbuild/kconfig-language.txt.
#
mainmenu "X-TRACK Configuration"

source Build/kconfig/kconfig.arch
source Build/kconfig/kconfig.build
source Build/kconfig/kconfig.peripheral
#source Build/kconfig/kconfig.vendor
```

## x_track/Build/kconfig/kconfig.arch
```kconfig
#
# For a description of the syntax of this configuration file,
# see Documentation/kbuild/kconfig-language.txt.
#

#comment "Architecture Configuration"

choice
	prompt "Architecture"
	help
		Select Architecture
	config ARM_ARCH
		bool "arm"
		help
			ARM Architecture
    config LINUX_X86_64
		bool "linux_x86_64"
		help
			Linux x86_64 Architecture
endchoice

#comment "Chip Configuration"

menu "Chip Vendor"
    choice
        prompt "Chip Vendor"
        depends on ARM_ARCH
        help
            Select Chip types
        config HISILICON
            bool "Hisilicon"
            help
                Hisilicon CPU type
        config SIGMASTAR
            bool "Sigmastar"
            help
                Sigmastar CPU type
        config ROCKCHIP
            bool "Rockchip"
            help
                Rockchip CPU type
        config ANYKA
            bool "Anyka"
            help
                Anyka CPU type
        config ALLWINNER
            bool "Allwinner"
            help
                Allwinner CPU type
    endchoice
endmenu

menu "Chip Type"
    choice
        prompt "Chip Type"
        depends on ARM_ARCH
        help
            Select Chip types
        config HI3516EV200
            bool "Hi3516ev200"
	    	depends on HISILICON
            help
                CPU is Single Core Cortex A7
        config HI3556V100
            bool "Hi3556v100"
			depends on HISILICON
            help
                CPU is Dual Core Cortex A53 and Cortex A53
        config HI3559V200
            bool "Hi3559v200"
			depends on HISILICON
            help
                CPU is Dual Core Cortex A7 and Cortex A7
        config SSC325
            bool "ssc325"
			depends on SIGMASTAR
            help
                CPU is Single Core Cortex A7
        config SSC335
            bool "ssc335"
			depends on SIGMASTAR
            help
                CPU is Single Core Cortex A7
	config RV1109
            bool "rv1109"
			depends on ROCKCHIP
            help
                CPU is Single Core Cortex A7		
	config AK3918EV331
            bool "ak3918ev331"
			depends on ANYKA
            help
                CPU is Single Core Cortex A7	
	config R329
            bool "r329"
			depends on ALLWINNER
            help
                CPU is Single Core Cortex A53	                
    endchoice
endmenu

menu "ToolChain"
	choice
		prompt "Cross Compiler"
		depends on HISILICON || SIGMASTAR || ROCKCHIP || ANYKA || ALLWINNER
		config CROSS_COMPILE_HISIV600
			bool "arm-hisiv600-linux-"
			depends on (HISILICON) && (HI3559V100 || HI3556V100)
		config CROSS_COMPILE_HIMIX100
			bool "arm-himix100-linux-"
			depends on (HISILICON) && (HI3559V200 || HI3556V200 || HI3516EV200)
		config CROSS_COMPILE_UCLIBC_HARD_FLOAT
			bool "arm-buildroot-linux-uclibcgnueabihf-"
			depends on (SIGMASTAR) && (SSC325 || SSC335)
		config CROSS_COMPILE_RV_UCLIBC_HARD_FLOAT
			bool "arm-buildroot-linux-uclibcgnueabihf-"
			depends on (ROCKCHIP) && (RV1109)
		config CROSS_COMPILE_ANYKA_UCLIBC_HARD_FLOAT
			bool "arm-anykav500-linux-uclibcgnueabi-"
			depends on (ANYKA) && (AK3918EV331)
        config CROSS_COMPILE_AARCH64_OPENWRT
			bool "aarch64-openwrt-linux-"
			depends on (ALLWINNER) && (R329)
	endchoice
    choice
		prompt "GNU"
		depends on LINUX_X86 || LINUX_X86_64
        config CROSS_COMPILE_GNU
			bool "gnu"
			depends on LINUX_X86 || LINUX_X86_64
	endchoice
endmenu
```

## x_track/Build/kconfig/kconfig.build
```kconfig
#
# For a description of the syntax of this configuration file,
# see build/scripts/Documentation/kbuild/kconfig-language.txt.
#
#comment "Build Configuration"

menu "Build Configure"
	choice
		prompt "Build Type"
		default RELEASE
		config DEBUG
			bool "Debug"
		config RELEASE
			bool "Release"
	endchoice
	choice
		prompt "Log Level"
		depends on DEBUG
		default LOG_LEVEL_DEBUG
		config LOG_LEVEL_ERR
			bool "ERROR_LEVEL"
		config LOG_LEVEL_DEBUG
			bool "DEBUG_LEVEL"
	endchoice
    choice
		prompt "Log File"
		default LOG_FILE_OFF
        config LOG_FILE_ON
			bool "Enable"
		config LOG_FILE_OFF
			bool "Disable"
	endchoice
endmenu
```

## x_track/Build/kconfig/kconfig.peripheral
```kconfig
#
# For a description of the syntax of this configuration file,
# see Documentation/kbuild/kconfig-language.txt.
#

#comment "Peripheral Configuration"

menu "Peripheral"
    choice
        prompt "Sensor"
        help
            Select Sensor
        config GALAXYCORE_GC2053
            bool "galaxycore_gc2053"
            depends on (HISILICON) && (HI3516EV200)
            help
                Galaxycore GC2053 Set
        config GALAXYCORE_GC2053CAR
            bool "galaxycore_gc2053car"
            depends on (HISILICON) && (HI3516EV200)
            help
                Galaxycore GC2053CAR Set
        config OMNIVISION_OV2735
            bool "omnivision_ov2735"
            depends on (HISILICON) && (HI3516EV200)
            help
                Omnivision OV2735 Set
        config SMART_SC2231
            bool "smart_sc2231"
            depends on (HISILICON) && (HI3516EV200)
            help
                Smart SC2231 Set
        config SOI_F37
            bool "soi_f37"
            depends on (HISILICON) && (HI3516EV200)
            help
                Soi F37 Set
        config SONY_IMX307
            bool "sony_imx307"
            depends on (HISILICON) && (HI3516EV200)
            help
                Sony IMX307 Set
    endchoice
endmenu
```

## x_track/Build/kconfig/kconfig.vendor
```kconfig
#
# For a description of the syntax of this configuration file,
# see Documentation/kbuild/kconfig-language.txt.
#

#comment "Vendor Configuration"

choice
	prompt "Vendor"
	help
		Select Vendor
	config HISILICON
		bool "Hisilicon"
		help
			Hisilicon Chip Set
	config ROCKCHIP
		bool "Rockchip"
		help
			Rockchip Chip Set
	config SIGMASTAR
		bool "Sigmastar"
		help
			Sigmastar Chip 
	config ANYKA
		bool "Anyka"
		help
			Anyka Chip Set
endchoice
```
